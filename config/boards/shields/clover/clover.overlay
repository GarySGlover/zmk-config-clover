/ {
    chosen {
        zmk,kscan = &kscan0;
    };

    kscan0: kscan {
        compatible = "zmk,kscan-gpio-direct";
        label = "KSCAN";

        input-gpios = <
            &gpio0 0 (GPIO_ACTIVE_HIGH | GPIO_PULL_DOWN)
            &gpio0 1 (GPIO_ACTIVE_HIGH | GPIO_PULL_DOWN)
            &gpio0 2 (GPIO_ACTIVE_HIGH | GPIO_PULL_DOWN)
            &gpio0 3 (GPIO_ACTIVE_HIGH | GPIO_PULL_DOWN)
            >;
    };
};
